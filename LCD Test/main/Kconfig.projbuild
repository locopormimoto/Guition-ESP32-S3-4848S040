## LCD Test/main/Kconfig.projbuild
```kconfig
menu "Example Configuration"
    config DOUBLE_FB
        bool "Use double Frame Buffer"
        default "n"
        help
            Enable this option, driver will allocate two frame buffers.

    config USE_BOUNCE_BUFFER
        depends on !DOUBLE_FB
        bool "Use bounce buffer"
        help
            Enable bounce buffer mode can achieve higher PCLK frequency at the cost of higher CPU consumption.

    config AVOID_TEAR_EFFECT_WITH_SEM
        depends on !DOUBLE_FB
        bool "Avoid tearing effect"
        default "y"
        help
            Enable this option, the example will use a pair of semaphores to avoid the tearing effect.
            Note, if the Double Frame Buffer is used, then we can also avoid the tearing effect without the lock.

endmenu
```
